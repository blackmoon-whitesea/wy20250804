#include "Audio.h" 
#include "usart.h" 
#include "delay.h" 
#include "malloc.h"
#include "i2s.h"
#include "wm8978.h"
#include "key.h"
#include "rtp.h"
#include "SipFunction.h"
#include "SipConstant.h"
#include "tel_func.h"

#define RING_HEX_LEN		163*16
const vu8 gRingArr[RING_HEX_LEN]={
0x1D ,0x07 ,0x06 ,0x1B ,0x69 ,0xFB ,0x98 ,0x82 ,0x8F ,0x82 ,0x98 ,0xDF ,0x1A ,0x0B ,0x31 ,0x32,
0x30 ,0x35 ,0x1B ,0xE7 ,0x8D ,0xB6 ,0xBD ,0xB2 ,0xB6 ,0x80 ,0x54 ,0x00 ,0x36 ,0x3D ,0x3D ,0x36,
0x01 ,0xC0 ,0x82 ,0xB1 ,0xBD ,0xBD ,0xB7 ,0x85 ,0x15 ,0x35 ,0x3C ,0x3B ,0x38 ,0x32 ,0x0C ,0xC7,
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0x00 ,0x04 ,0x1D ,0x62 ,0xDA ,0xEB ,0x9E ,0x87 ,0x81 ,0x86 ,0x85 ,0x93 ,0xE4 ,0x7D ,0x16 ,0x1A,
};	


__audiodev gsAudio;	

void AUDIO_Init(void)
{	
	gsAudio.i2s_txbuf1=mymalloc(SRAMIN,I2S_DMA_BUF_SIZE);
	gsAudio.i2s_txbuf2=mymalloc(SRAMIN,I2S_DMA_BUF_SIZE);		
	gsAudio.i2s_rxbuf1=mymalloc(SRAMIN,I2S_DMA_BUF_SIZE);//I2S录音内存1申请
	gsAudio.i2s_rxbuf2=mymalloc(SRAMIN,I2S_DMA_BUF_SIZE);//I2S录音内存2申请
//	gsAudio.rtp_txbuf=mymalloc(SRAMIN,RTP_BUF_LEN);
//	gsAudio.rtp_rxbuf=mymalloc(SRAMIN,RTP_BUF_LEN);
	
	I2S2_Init(I2S_Standard_PCMShort,I2S_Mode_MasterTx,I2S_CPOL_Low,I2S_DataFormat_16b);			//PCM模式,主机发送,时钟低电平有效,16位帧长度 
	I2S2ext_Init(I2S_Standard_PCMShort,I2S_Mode_SlaveRx,I2S_CPOL_Low,I2S_DataFormat_16b);		//PCM模式,从机接收,时钟低电平有效,16位帧长度	
	I2S2_SampleRate_Set(8000);	//设置采样率 
	
	I2S2_TX_DMA_Init(gsAudio.i2s_txbuf1,gsAudio.i2s_txbuf2,I2S_DMA_BUF_SIZE/2); //配置TX DMA
	I2S2ext_RX_DMA_Init(gsAudio.i2s_rxbuf1,gsAudio.i2s_rxbuf2,I2S_DMA_BUF_SIZE/2); 	//配置RX DMA: 因为I2S数据长度16位所以RX_DMA_BUF_SIZE/2
	
	i2s_tx_callback=AUDIO_i2s_dma_tx_callback;			//回调函数指play_i2s_dma_callback
	i2s_rx_callback=AUDIO_i2s_dma_rx_callback;			//回调函数指rec_i2s_dma_callback
	
	
	
	I2S_Play_Stop();					//停止时钟发送
	I2S_Rec_Stop(); 					//停止录音
	gsAudio.rtp_rx_num =0;
	gRtpRxNum =0;
	gsAudio.rtp_tx_num =0;
	gRtpTxNum =0;
}

/*	 
//将Rec(ADC)采样数据
//buf:数据区
//size:填充数据量
//bits:位数(16/24)
*/
void AUDIO_recfill(u8 *buf,u16 size)
{
	u16 i,fill_len;
	fill_len =(size>>2);	//div 4
	for(i =0; i<fill_len; i++){
		gRtpTxBuf[gsAudio.rtp_tx_num][i] = buf[i*4+1];//*(buf+i*4+1);//		
	}			
	gsAudio.rtp_tx_num ++;
	gsAudio.rtp_tx_num &= (~RTP_BUF_NUM);	//注：必须是2,4,8,16....
//	printf("a=%d\r\n",gsAudio.rtp_tx_num);
} 
					
//录音 I2S_DMA接收中断服务函数.在中断里面写入数据
void AUDIO_i2s_dma_rx_callback(void) 
{ 
	if(DMA1_Stream3->CR&(1<<19))
	{
		AUDIO_recfill(gsAudio.i2s_rxbuf1,I2S_DMA_BUF_SIZE);			 
	}else 
	{
		AUDIO_recfill(gsAudio.i2s_rxbuf2,I2S_DMA_BUF_SIZE);		
	}
}  

void AUDIO_ringfill(u8 *buf,u16 size)
{
	static u32 hex_len=0;
	static u8 hex_flag,hex_times=0;
	u16 i,fill_len;	
	
	fill_len = (size>>2);		//div 8
	if(hex_flag ==0){
		for(i =0; i< fill_len; i++){
			buf[i*4+0]=gRingArr[hex_len];
			buf[i*4+1]=gRingArr[hex_len];
			buf[i*4+2]=gRingArr[hex_len];
			buf[i*4+3]=gRingArr[hex_len];
			hex_len++;
			if(hex_len>=RING_HEX_LEN){
				hex_len=0;
			}	
		}		
		hex_times ++;		
		if(hex_times ==100){
			hex_flag =1;
//			printf("%d\r\n",hex_len);
		}
	}
	else{
		for(i =0; i< size; i++){
			buf[i]=0xd5;
		}		
		hex_times ++;
		if(hex_times ==25){
			hex_flag =0;
			hex_len=368;
		}
	}	
}  


/*	 
//填充buf
//buf:数据区
//size:填充数据量
//bits:位数(16/24)
*/
void AUDIO_playfill(u8 *buf,u16 size)
{
	u16 i,j,fill_len;	
	fill_len = (size>>2);		//div 8
	if(gsAudio.rtp_rx_num != gRtpRxNum){
		for(i =0,j=12; i< fill_len; i++,j++){
			buf[i*4+0]=gRtpRxBuf[gsAudio.rtp_rx_num][j];
			buf[i*4+1]=gRtpRxBuf[gsAudio.rtp_rx_num][j];
			buf[i*4+2]=gRtpRxBuf[gsAudio.rtp_rx_num][j];
			buf[i*4+3]=gRtpRxBuf[gsAudio.rtp_rx_num][j];
		}	
		gsAudio.rtp_rx_num ++;
		gsAudio.rtp_rx_num &= (~RTP_BUF_NUM);	//注：必须是2,4,8,16....
	//	printf("a=%d\r\n",gsAudio.rtp_rx_num);
	}
}  

//WAV播放时,I2S DMA传输回调函数
void AUDIO_i2s_dma_tx_callback(void) 
{ 
	if(DMA1_Stream4->CR&(1<<19))
	{
		if(gsSipTxFlag.ringing ==1){
			AUDIO_ringfill(gsAudio.i2s_txbuf1,I2S_DMA_BUF_SIZE);
		}
		else{
			AUDIO_playfill(gsAudio.i2s_txbuf1,I2S_DMA_BUF_SIZE);
		}
	}else 
	{
		if(gsSipTxFlag.ringing ==1){
			AUDIO_ringfill(gsAudio.i2s_txbuf2,I2S_DMA_BUF_SIZE);
		}
		else{
			AUDIO_playfill(gsAudio.i2s_txbuf2,I2S_DMA_BUF_SIZE);
		}
	}
} 

/*
*/
void AUDIO_rec_mode(void)
{	
	I2S_Play_Start();		//开始I2S数据发送(主机)
	I2S_Rec_Start(); 		//开始I2S数据接收(从机)

//rtp packet
	gsAudio.rtp_rx_num =0;
	gRtpRxNum =0;
	gsAudio.rtp_tx_num =0;
	gRtpTxNum =0;
}

/*
*/	
void AUDIO_play_mode(void)
{
	I2S_Play_Start();					//停止时钟发送
}

void AUDIO_stop_mode(void)
{
	I2S_Play_Stop();					//停止时钟发送
	I2S_Rec_Stop(); 					//停止录音
}

